## meta-tfs/conf/layer.conf
```bitbake
# We have a conf and classes directory, add to BBPATH
BBPATH .= ":${LAYERDIR}"

# We have recipes-* directories, add to BBFILES
BBFILES += "${LAYERDIR}/recipes-*/*/*.bb \
            ${LAYERDIR}/recipes-*/*/*.bbappend"

BBFILE_COLLECTIONS += "meta-tfs"
BBFILE_PATTERN_meta-tfs = "^${LAYERDIR}/"
BBFILE_PRIORITY_meta-tfs = "6"

LAYERDEPENDS_meta-tfs = "core"
LAYERSERIES_COMPAT_meta-tfs = "langdale"
```
